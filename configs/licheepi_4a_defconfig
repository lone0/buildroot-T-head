## configs/licheepi_4a_defconfig
```kconfig
# Target options
#
BR2_ARCH_IS_64=y
BR2_USE_MMU=y
BR2_riscv=y
BR2_ARCH_HAS_TOOLCHAIN_BUILDROOT=y
BR2_ARCH="riscv64"
BR2_NORMALIZED_ARCH="riscv"
BR2_ENDIAN="LITTLE"
BR2_GCC_TARGET_ABI="lp64d"
BR2_READELF_ARCH_NAME="RISC-V"
BR2_RISCV_ISA_RVI=y
BR2_RISCV_ISA_RVM=y
BR2_RISCV_ISA_RVA=y
BR2_RISCV_ISA_RVF=y
BR2_RISCV_ISA_RVD=y
BR2_riscv_g=y
BR2_RISCV_64=y
BR2_RISCV_USE_MMU=y
BR2_RISCV_ABI_LP64D=y

#
# Kernel Header Options
#
BR2_KERNEL_HEADERS_AS_KERNEL=y
BR2_PACKAGE_HOST_LINUX_HEADERS_CUSTOM_5_10=y

#
# Binutils Options
#
BR2_PACKAGE_HOST_BINUTILS_SUPPORTS_CFI=y
BR2_BINUTILS_VERSION_THEAD=y
BR2_BINUTILS_VERSION="t-head-semi-2.35"
BR2_BINUTILS_EXTRA_CONFIG_OPTIONS=""
BR2_GLOBAL_PATCH_DIR="board/licheepi-4a/patches"

# System configuration
BR2_ROOTFS_SKELETON_DEFAULT=y
BR2_TARGET_GENERIC_HOSTNAME="licheepi4a"
BR2_TARGET_GENERIC_ISSUE="Welcome to Buildroot for the LicheePi 4A"
BR2_TARGET_GENERIC_GETTY=y
BR2_TARGET_GENERIC_GETTY_PORT="ttyS0"
BR2_TARGET_GENERIC_GETTY_BAUDRATE_115200=y
BR2_TARGET_GENERIC_REMOUNT_ROOTFS_RW=y
BR2_ROOTFS_POST_IMAGE_SCRIPT="board/licheepi-4a/post-image.sh"
BR2_ROOTFS_POST_SCRIPT_ARGS=""


#
# Kernel
#
BR2_LINUX_KERNEL=y
BR2_LINUX_KERNEL_CUSTOM_GIT=y
BR2_LINUX_KERNEL_CUSTOM_REPO_URL="https://github.com/revyos/thead-kernel.git"
BR2_LINUX_KERNEL_CUSTOM_REPO_VERSION="7a1ebd4adb2fbf73db0c6d0ce114b2fff7a4f7bb"
BR2_LINUX_KERNEL_USE_DEFCONFIG=y
BR2_LINUX_KERNEL_DEFCONFIG="revyos"
BR2_LINUX_KERNEL_IMAGE=y
BR2_LINUX_KERNEL_DTS_SUPPORT=y
BR2_LINUX_KERNEL_INTREE_DTS_NAME="thead/light-lpi4a"

#
# Filesystem images
#

BR2_TARGET_ROOTFS_EXT2=y
BR2_TARGET_ROOTFS_EXT2_4=y

#
# Bootloaders
#
BR2_TARGET_OPENSBI=y
BR2_TARGET_OPENSBI_CUSTOM_GIT=y
BR2_TARGET_OPENSBI_CUSTOM_REPO_URL="https://github.com/revyos/thead-opensbi"
BR2_TARGET_OPENSBI_CUSTOM_REPO_VERSION="d98da90a19b5c71a5865ae17c8b2d8d210e78f19"
BR2_TARGET_OPENSBI_VERSION="d98da90a19b5c71a5865ae17c8b2d8d210e78f19"
BR2_TARGET_OPENSBI_PLAT="generic"
BR2_TARGET_OPENSBI_INSTALL_DYNAMIC_IMG=y
BR2_TARGET_UBOOT=y
BR2_TARGET_UBOOT_BOARDNAME="light_lpi4a"
BR2_TARGET_UBOOT_CUSTOM_GIT=y
BR2_TARGET_UBOOT_CUSTOM_REPO_URL="https://github.com/revyos/thead-u-boot.git"
BR2_TARGET_UBOOT_CUSTOM_REPO_VERSION="b5768043c2128370424c06f8b197700356355384"
BR2_TARGET_UBOOT_VERSION="b5768043c2128370424c06f8b197700356355384"

#
# U-Boot binary format
#
BR2_TARGET_UBOOT_FORMAT_BIN=y
BR2_TARGET_UBOOT_SPL=y
BR2_TARGET_UBOOT_SPL_NAME="u-boot-with-spl.bin"



# Required host utilities for building an SDCard image
BR2_PACKAGE_HOST_GENIMAGE=y
BR2_PACKAGE_HOST_MTOOLS=y
```

## configs/sipeed_licheepi_4a_defconfig
```kconfig
# Target options
#
BR2_ARCH_IS_64=y
BR2_USE_MMU=y
BR2_riscv=y
BR2_ARCH_HAS_TOOLCHAIN_BUILDROOT=y
BR2_ARCH="riscv64"
BR2_NORMALIZED_ARCH="riscv"
BR2_ENDIAN="LITTLE"
BR2_GCC_TARGET_ABI="lp64d"
BR2_READELF_ARCH_NAME="RISC-V"
BR2_riscv_g=y
BR2_RISCV_ISA_RVI=y
BR2_RISCV_ISA_RVM=y
BR2_RISCV_ISA_RVA=y
BR2_RISCV_ISA_RVF=y
BR2_RISCV_ISA_RVD=y
BR2_RISCV_ISA_RVC=y
BR2_RISCV_ISA_RVV=y
BR2_RISCV_64=y
BR2_RISCV_USE_MMU=y
BR2_RISCV_ABI_LP64D=y

#
# Kernel Header Options
#
BR2_KERNEL_HEADERS_AS_KERNEL=y
BR2_PACKAGE_HOST_LINUX_HEADERS_CUSTOM_6_6=y

#
# Binutils Options
#
BR2_PACKAGE_HOST_BINUTILS_SUPPORTS_CFI=y
# BR2_BINUTILS_VERSION_2_39_X is not set
# BR2_BINUTILS_VERSION_2_40_X is not set
BR2_BINUTILS_VERSION_2_41_X=y
BR2_BINUTILS_VERSION="2.41"
# BR2_BINUTILS_GPROFNG is not set
BR2_GLOBAL_PATCH_DIR="board/sipeed/licheepi_4a/patches"

# System configuration
BR2_ROOTFS_SKELETON_DEFAULT=y
BR2_TARGET_GENERIC_HOSTNAME="licheepi4a"
BR2_TARGET_GENERIC_ISSUE="Welcome to Buildroot for the LicheePi 4A"
BR2_TARGET_GENERIC_GETTY=y
BR2_TARGET_GENERIC_GETTY_PORT="ttyS0"
BR2_TARGET_GENERIC_GETTY_BAUDRATE_115200=y
BR2_TARGET_GENERIC_REMOUNT_ROOTFS_RW=y
BR2_ROOTFS_POST_IMAGE_SCRIPT="board/sipeed/licheepi_4a/post-image.sh"
BR2_ROOTFS_POST_SCRIPT_ARGS=""


#
# Kernel
#
BR2_LINUX_KERNEL=y
# BR2_LINUX_KERNEL_LATEST_VERSION is not set
# BR2_LINUX_KERNEL_LATEST_CIP_VERSION is not set
# BR2_LINUX_KERNEL_LATEST_CIP_RT_VERSION is not set
# BR2_LINUX_KERNEL_CUSTOM_VERSION is not set
# BR2_LINUX_KERNEL_CUSTOM_TARBALL is not set
BR2_LINUX_KERNEL_CUSTOM_GIT=y
# BR2_LINUX_KERNEL_CUSTOM_HG is not set
# BR2_LINUX_KERNEL_CUSTOM_SVN is not set
BR2_LINUX_KERNEL_CUSTOM_REPO_URL="https://github.com/esmil/linux.git"
BR2_LINUX_KERNEL_CUSTOM_REPO_VERSION="221850f11052260cccf575e41ed6986af4a2ebe3"
BR2_LINUX_KERNEL_VERSION="221850f11052260cccf575e41ed6986af4a2ebe3"
BR2_LINUX_KERNEL_PATCH=""
# BR2_LINUX_KERNEL_USE_DEFCONFIG is not set
# BR2_LINUX_KERNEL_USE_ARCH_DEFAULT_CONFIG is not set
BR2_LINUX_KERNEL_USE_CUSTOM_CONFIG=y
BR2_LINUX_KERNEL_CUSTOM_CONFIG_FILE="board/sipeed/licheepi_4a/th1520_defconfig"
BR2_LINUX_KERNEL_CONFIG_FRAGMENT_FILES=""
BR2_LINUX_KERNEL_CUSTOM_LOGO_PATH=""
BR2_LINUX_KERNEL_IMAGE=y
BR2_LINUX_KERNEL_DTS_SUPPORT=y
BR2_LINUX_KERNEL_INTREE_DTS_NAME="thead/th1520-lichee-pi-4a"
#
# Target packages
#
BR2_PACKAGE_BUSYBOX_SHOW_OTHERS=y
BR2_PACKAGE_HDPARM=y

#
# Filesystem images
#

BR2_TARGET_ROOTFS_EXT2=y
BR2_TARGET_ROOTFS_EXT2_4=y

#
#
# Bootloaders
#
BR2_TARGET_OPENSBI=y
BR2_TARGET_OPENSBI_CUSTOM_GIT=y
BR2_TARGET_OPENSBI_CUSTOM_REPO_URL="https://github.com/xhackerustc/thead-opensbi.git"
BR2_TARGET_OPENSBI_CUSTOM_REPO_VERSION="lpi4a"
BR2_TARGET_OPENSBI_VERSION="lpi4a"
BR2_TARGET_OPENSBI_PLAT="generic"
BR2_TARGET_OPENSBI_INSTALL_DYNAMIC_IMG=y
BR2_TARGET_UBOOT=y
BR2_TARGET_UBOOT_BOARDNAME="light_lpi4a"
BR2_TARGET_UBOOT_CUSTOM_GIT=y
BR2_TARGET_UBOOT_CUSTOM_REPO_URL="https://github.com/revyos/thead-u-boot.git"
BR2_TARGET_UBOOT_CUSTOM_REPO_VERSION="fc9575fa63442ae87ced0b147ca1a14e30fd3d3d"
BR2_TARGET_UBOOT_VERSION="fc9575fa63442ae87ced0b147ca1a14e30fd3d3d"

#
# U-Boot binary format
#
BR2_TARGET_UBOOT_FORMAT_BIN=y
BR2_TARGET_UBOOT_SPL=y
BR2_TARGET_UBOOT_SPL_NAME="u-boot-with-spl.bin"



# Required host utilities for building an SDCard image
BR2_PACKAGE_HOST_GENIMAGE=y
BR2_PACKAGE_HOST_MTOOLS=y
```
